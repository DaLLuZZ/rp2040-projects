

#ifndef LABYRINTH_VISUAL_ITEMS_H
#define LABYRINTH_VISUAL_ITEMS_H


#include <vector>
#include <lcd_interface.h>

/// @brief A torch as a vector<vector<uint16_t RGB565>>
const std::vector<std::vector<uint16_t>> torchGrid = {
        // Brennende Fackel
        {0x0000, 0x0000, 0x0000, 0x0000, 0x0000, 0x0000, 0xFF00, 0x0000},
        {0x0000, 0x0000, 0x0000, 0x0000, 0x0000, 0xB200, 0xD900, 0x4000},
        {0x0000, 0x4000, 0x0000, 0x0000, 0x0000, 0xD900, 0xFF33, 0x6600},
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        {0x0000, 0x0000, 0x0000, 0x2000, 0x2000, 0x0000, 0x0000, 0x0000}
};

/// @brief Mirrors the input in the middle on the y axis
/// @param eingabe vector<vector<uint16_t RGB565>>
/// @return vector<vector<uint16_t RGB565>>
static std::vector<std::vector<uint16_t>> mirrorAsset(const std::vector<std::vector<uint16_t>>& eingabe) {
    // Erstelle einen neuen Vektor mit den gleichen Dimensionen wie die Eingabe
    std::vector<std::vector<uint16_t>> gespiegelt(eingabe.size(), std::vector<uint16_t>(eingabe[0].size(), 0));

    // Zeilenweise Spiegelung der Einträge
    for (size_t i = 0; i < eingabe.size(); ++i) {
        for (size_t j = 0; j < eingabe[i].size(); ++j) {
            gespiegelt[i][j] = eingabe[i][eingabe[i].size() - 1 - j];
        }
    }

    // Rückgabe des gespiegelten Vektors
    return gespiegelt;
}

///@brief The mirrored torch
const std::vector<std::vector<uint16_t>> torchGridMirrored = mirrorAsset(torchGrid);


/// @brief conversion from vector<vector<uint16_t RGB565>> to vector<uint16_t RGB565> to be used with pixel_stream and drawArea()
/// @param grid 
/// @return 
static std::vector<uint16_t> convert_vecvec_to_vec(const std::vector<std::vector<uint16_t>>& grid) {
    std::vector<uint16_t> result;
    for (const auto& row : grid) {
        for (const auto& color : row) {
            result.push_back(color);
        }
    }
    return result;
}

/// @brief 
/// @return std::vector<uint16_t> representing a 8 x 32 grid of a torch
static std::vector<uint16_t> getTorch(){
    return convert_vecvec_to_vec(torchGrid);
}

/// @brief 
/// @return std::vector<uint16_t> representing a 8 x 32 grid of a torch
static std::vector<uint16_t> getMirroredTorch(){
    return convert_vecvec_to_vec(torchGridMirrored);
}



#endif //LABYRINTH_VISUAL_ITEMS_H
